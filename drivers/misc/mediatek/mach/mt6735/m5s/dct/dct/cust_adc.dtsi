/*
 * Generated by MTK SP DrvGen Version 03.13.6 for MT6753. Copyright MediaTek Inc. (C) 2013.
 * Sun Sep 11 02:21:42 2016
 * Do Not Modify the File.
 */

/********************************************
 *ADC DTSI File
********************************************/

/* M1612 note: file NOT included in the DTS build (only cust.dtsi is).
 * Synced with live DT soc/adc_hw@11001000/adc_channel@: battery_voltage=12,
 * adc_fdd_rf_params_dynamic_custom_ch=13 added. */
&auxadc {
	AUXADC@ {
		compatible = "mediatek, AUXADC_CH";
		TEMPERATURE = <0>;
		TEMPERATURE1 = <1>;
		BATTERY_VOLTAGE = <12>;
		ADC_FDD_RF_PARAMS_DYNAMIC_CUSTOM_CH = <13>;
	};
};
